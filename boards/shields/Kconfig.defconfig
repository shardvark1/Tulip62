## boards/shields/Kconfig.defconfig
```kconfig
if TULIP64_LEFT

config ZMK_KEYBOARD_NAME
    default "Tulip64"

config ZMK_SPLIT_ROLE_CENTRAL
    default y

endif

if TULIP64_LEFT || TULIP64_RIGHT

config ZMK_SPLIT
    default y

endif
```

## boards/shields/Kconfig.shield
```kconfig
config TULIP64_LEFT
    def_bool $(shields_list_contains,Tulip64_left)

config TULIP64_RIGHT
    def_bool $(shields_list_contains,Tulip64_right)
```

## boards/shields/Tulip64/Kconfig.defconfig
```kconfig
if SHIELD_TULIP64_LEFT

config ZMK_KEYBOARD_NAME
    default "Tulip64"

config ZMK_SPLIT_ROLE_CENTRAL
    default y

endif

if SHIELD_TULIP64_LEFT || SHIELD_TULIP64_RIGHT

config ZMK_SPLIT
    default y

endif
```

## boards/shields/Tulip64/Kconfig.shield
```kconfig
config SHIELD_TULIP64_LEFT
    def_bool $(shields_list_contains,Tulip64_left)

config SHIELD_TULIP64_RIGHT
    def_bool $(shields_list_contains,Tulip64_right)
```
